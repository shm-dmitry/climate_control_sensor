## main/Kconfig.projbuild
```kconfig
menu "Climate Control Configuration"
   menu "WIFI Configuration"
   	  config WIFI_SSID
   	  	string "Wifi AP SSID"
   	  	default ""

   	  config WIFI_PASSWORD
   	  	string "Wifi AP Password"
   	  	default ""
   	  	
   	  config WIFI_TOPIC
   	  	string "WiFi MQTT Topic to listen Change-SSID command"
   	  	default "/hws/system/0/wifi/command"
   endmenu

   menu "MQTT Configuration"
      config MQTT_BROKER_URI
         string "Broker URL"
         default ""

      config MQTT_BROKER_USERNAME
	     string "Broker user name"
	     default ""

      config MQTT_BROKER_PASSWORD
	     string "Broker user password"
	     default ""

      config MQTT_INIT_LOGGER_ENABLED
	     boolean "Enable log init messages to MQTT topic"
	     default true

      config MQTT_INIT_LOGGER_TOPIC
	     string "MQTT Init logger topic"
	     default "/hws/system/0/logger/init"

      config MQTT_LIVE_LOGGER_ENABLED
	     boolean "Enable log live messages to MQTT topic"
	     default true

      config MQTT_LIVE_LOGGER_TOPIC
	     string "MQTT live logger topic"
	     default "/hws/system/0/logger/live"
   endmenu

   menu "I2C configuration"
      config I2C_PORT_0_ENABLED
         boolean "Enable I2C port#0"
         default true

      config I2C_PORT_0_GPIO_SDA
         int "GPIO SDA pin for I2C port#0"
         default 21

      config I2C_PORT_0_GPIO_SCL
         int "GPIO SCL pin for I2C port#0"
         default 23

      config I2C_PORT_1_ENABLED
         boolean "Enable I2C port#1"
         default false

      config I2C_PORT_1_GPIO_SDA
         int "GPIO SDA pin for I2C port#1"
         default 0

      config I2C_PORT_1_GPIO_SCL
         int "GPIO SCL pin for I2C port#1"
         default 0
   endmenu   

   menu "TION configuration"
      config TION_ENABLED
         bool "Enable TION integration"
         default false

      config TION_MQTT_TOPIC_STATUS
         string "MQTT topic for TION device status information"
         default "/hws/tion/0/status"

      config TION_MQTT_TOPIC_COMMANDS
         string "MQTT topic for TION device awaits commands"
         default "/hws/tion/0/command"
   endmenu
   
   menu "BME280 configuration (pressure, temperature, humidity)"
      config BME280_ENABLED
         bool "Enable BME280 integration"
         default false

      config BME280_TOPIC_STATUS
         string "MQTT topic for BME280 device status information"
         default "/hws/bme280/0/status"

      config BME280_PORT
         int "BME280 I2C port"
         default 0
   endmenu

   menu "SGP30 configuration (TVOC, eCO2)"
      config SGP30_ENABLED
         bool "Enable SGP30 integration"
         default false
 
      config SGP30_TOPIC_STATUS
         string "MQTT topic for SGP30 device status information"
         default "/hws/sgp30/0/status"

	  config SGP30_TOPIC_COMMAND
         string "MQTT topic for SGP30 device listen commands"
         default "/hws/sgp30/0/command"

      config SGP30_PORT
         int "SGP30 I2C port"
         default 0

      config SGP30_APPLI_COMPENSATION
         bool "Automatic apply compensation to SGP30 from BME280 data"
         default true
   endmenu

   menu "BH1750 configuration (illumination)"
      config BH1750_ENABLED
         bool "Enable BH1750 integration"
         default false

      config BH1750_TOPIC_STATUS
         string "MQTT topic for BH1750 device status information"
         default "/hws/bh1750/0/status"

      config BH1750_PORT
         int "BH1750 I2C port"
         default 0
   endmenu

   menu "MH-Z19B configuration (CO2)"
      config MH_Z19B_ENABLED
         bool "Enable MH-Z19B integration"
         default false
      
      config MH_Z19B_UART_PORT
         int "UART Port number"
         default 0

      config MH_Z19B_UART_PIN_RXD
         int "UART Pin RXD"
         default 3

      config MH_Z19B_UART_PIN_TXD
         int "UART Pin TXD"
         default 1

      config MH_Z19B_MQTT_TOPIC_STATUS
         string "MQTT topic for MH-Z19B device status information"
         default "/hws/mhz19b/0/status"

      config MH_Z19B_MQTT_TOPIC_COMMAND
         string "MQTT topic for MH-Z19B device awaits commands"
         default "/hws/mhz19b/0/command"
   endmenu

   menu "PMS7003 configuration (PM1.0, PM2.5, PM10.0)"
      config PMS7003_ENABLED
         bool "Enable PMS7003 integration"
         default false

      config PMS7003_UART_PORT
         int "UART Port number"
         default 1

      config PMS7003_UART_PIN_RXD
         int "UART Pin RXD"
         default 9

      config PMS7003_UART_PIN_TXD
         int "UART Pin TXD"
         default 10

      config PMS7003_MQTT_TOPIC_STATUS
         string "MQTT topic for PMS7003 device status information"
         default "/hws/pms7003/0/status"
   endmenu

   menu "RGB Led configuration (RGB led)"
      config RGBLED_ENABLED
         bool "Enable RGBLED integration"
         default false

      config RGBLED_GPIO_RED
         int "GPIO red pin"
         default 25

      config RGBLED_GPIO_GREEN
         int "GPIO green pin"
         default 26

      config RGBLED_GPIO_BLUE
         int "GPIO blue pin"
         default 27

      config RGBLED_MQTT_TOPIC_COMMAND
         string "MQTT topic for RGB Led device awaits commands"
         default "/hws/rgbled/0/command"
   endmenu

   menu "FAN configuration (fan: on/off)"
      config FAN_ENABLED
         bool "Enable FAN integration"
         default false

      config FAN_GPIO
         int "GPIO pin"
         default 32

      config FAN_MQTT_TOPIC_COMMAND
         string "MQTT topic for FAN device awaits commands"
         default "/hws/fan/0/command"

      config FAN_MQTT_TOPIC_STATUS
         string "MQTT topic for FAN device send current status"
         default "/hws/fan/0/status"
   endmenu

   menu "FAN PWM configuration (fan: off-on_with_speed)"
      config FAN_PWM_ENABLED
         bool "Enable FAN PWM integration"
         default false

      config FAN_PWM_GPIO
         int "GPIO pin"
         default 25

      config FAN_PWM_MQTT_TOPIC_COMMAND
         string "MQTT topic for FAN PWM device awaits commands"
         default "/hws/fanpwm/0/command"
   endmenu

   menu "IR configuration (Control other devices via IR)"
      config IR_ENABLED
         bool "Enable IR integration"
         default false

      config IR_GPIO
         int "GPIO pin"
         default 2

      config IR_MQTT_TOPIC_COMMAND
         string "MQTT topic for FAN device awaits commands"
         default "/hws/ir/0/command"
   endmenu

   menu "Internal touch pad configuration (sensor buffon)"
      config TOUCH_ENABLED
         bool "Enable touch pad integration"
         default false

      config TOUCH_PIN
         int "Touch pin"
         default 4

      config TOUCH_MQTT_TOPIC_STATUS
         string "MQTT topic for touch pad device status information"
         default "/hws/touchpad/0/status"
   endmenu

   menu "Anemometer configuration (air direction, air speed, air consumption)"
      config ANEMOMETER_ENABLED
         bool "Enable Anemometer integration"
         default false

      config ANEMOMETER_GPIO_A
         int "GPIO pin A"
         default 39

      config ANEMOMETER_GPIO_B
         int "GPIO pin B"
         default 34

      config ANEMOMETER_MQTT_TOPIC_STATUS
         string "MQTT topic for anemometer device status information"
         default "/hws/anemometer/0/status"

      config ANEMOMETER_MQTT_TOPIC_COMMAND
         string "MQTT topic for anemometer device awaits commands"
         default "/hws/anemometer/0/command"
   endmenu
endmenu
```
